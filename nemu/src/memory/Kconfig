## nemu/src/memory/Kconfig
```kconfig
menu "Memory Configuration"

config MBASE
  hex "Memory base address"
  default 0x0        if ISA_x86
  default 0x80000000

config MSIZE
  hex "Memory size"
  default 0x8000000

config PC_RESET_OFFSET
  hex "Offset of reset vector from the base of memory"
  default 0x100000 if ISA_x86
  default 0

menuconfig HAS_MROM
  bool "Enable MROM"
  default y
  help
    Provide mrom support for difftest.

if HAS_MROM
config MROM_BASE
  hex "Physical address of the MROM"
  default 0x20000000

config MROM_SIZE
  hex "Size of the MROM"
  default 0x1000
endif # HAS_MROM

menuconfig HAS_FLASH
  bool "Enable FLASH"
  default y
  help
    Provide flash support for difftest.

if HAS_FLASH
config FLASH_BASE
  hex "Physical address of the FLASH"
  default 0x30000000

config FLASH_SIZE
  hex "Size of the FLASH"
  default 0x10000000
endif # HAS_FLASH

menuconfig HAS_SRAM
  bool "Enable SRAM"
  default y
  help
    Provide sram support for difftest.

if HAS_SRAM
config SRAM_BASE
  hex "Physical address of the SRAM"
  default 0x0F000000

config SRAM_SIZE
  hex "Size of the SRAM"
  default 0x2000
endif # HAS_SRAM

menuconfig HAS_PSRAM
  bool "Enable PSRAM"
  default y
  help
    Provide psram support for difftest.

if HAS_PSRAM
config PSRAM_BASE
  hex "Physical address of the PSRAM"
  default 0x80000000

config PSRAM_SIZE
  hex "Size of the PSRAM"
  default 0x20000000
endif # HAS_PSRAM

menuconfig HAS_SDRAM
  bool "Enable SDRAM"
  default y
  help
    Provide sdram support for difftest.

if HAS_SDRAM
config SDRAM_BASE
  hex "Physical address of the SDRAM"
  default 0xA0000000

config SDRAM_SIZE
  hex "Size of the SDRAM"
  default 0x20000000
endif # HAS_SDRAM

choice
  prompt "Physical memory definition"
  default PMEM_GARRAY
config PMEM_MALLOC
  bool "Using malloc()"
config PMEM_GARRAY
  depends on !TARGET_AM
  bool "Using global array"
endchoice

config MEM_RANDOM
  depends on MODE_SYSTEM && !DIFFTEST && !TARGET_AM
  bool "Initialize the memory with random values"
  default y
  help
    This may help to find undefined behaviors.

endmenu #MEMORY
```

## npc/src/main/csrc/isa/riscv32-npc/Kconfig
```kconfig
menu "ISA-dependent Options for riscv"

config RV64
  bool "64-bit RISC-V architecture"
  default n

config RVE
  bool "Use E extension"
  default n

menuconfig HAS_MROM
  bool "Enable MROM"
  default y
  help
    Provide mrom support.

if HAS_MROM
config MROM_BASE
  hex "Physical address of the MROM"
  default 0x20000000

config MROM_SIZE
  hex "Size of the MROM"
  default 0x1000
endif # HAS_MROM

menuconfig HAS_FLASH
  bool "Enable FLASH"
  default y
  help
    Provide sram support.

if HAS_FLASH
config FLASH_BASE
  hex "Physical address of the FLASH"
  default 0x30000000

config FLASH_SIZE
  hex "Size of the FLASH"
  default 0x1000000
endif # HAS_FLASH

menuconfig HAS_PSRAM
  bool "Enable PSRAM"
  default y
  help
    Provide sram support.

if HAS_PSRAM
config PSRAM_BASE
  hex "Physical address of the PSRAM"
  default 0x80000000

config PSRAM_SIZE
  hex "Size of the PSRAM"
  default 0x20000000
endif # HAS_PSRAM

menuconfig HAS_SDRAM
  bool "Enable SDRAM"
  default y
  help
    Provide sdram support.

if HAS_SDRAM
config SDRAM_BASE
  hex "Physical address of the SDRAM"
  default 0xA0000000

config SDRAM_SIZE
  hex "Size of the SDRAM"
  default 0x20000000
endif # HAS_SDRAM

endmenu
```

## npc/src/main/csrc/isa/riscv32_ysyxsoc/Kconfig
```kconfig
menu "ISA-dependent Options for riscv"

config RV64
  bool "64-bit RISC-V architecture"
  default n

config RVE
  bool "Use E extension"
  default n

menuconfig ISA_HAS_CLINT
  bool "Enable CLINT"
  default y
  help
    Provide clint support.

if ISA_HAS_CLINT
config CLINT_BASE
  hex "Physical address of the CLINT"
  default 0x02000000

config CLINT_SIZE
  hex "Size of the CLINT"
  default 0x10000
endif # ISA_HAS_CLINT

menuconfig ISA_HAS_SRAM
  bool "Enable SRAM"
  default y
  help
    Provide sram support.

if ISA_HAS_SRAM
config SRAM_BASE
  hex "Physical address of the SRAM"
  default 0x0f000000

config SRAM_SIZE
  hex "Size of the SRAM"
  default 0x01000000
endif # ISA_HAS_SRAM

menuconfig ISA_HAS_UART16550
  bool "Enable UART16550"
  default y
  help
    Provide uart16550 support.

if ISA_HAS_UART16550
config UART16550_BASE
  hex "Physical address of the UART16550"
  default 0x10000000

config UART16550_SIZE
  hex "Size of the UART16550"
  default 0x1000
endif # ISA_HAS_UART16550

menuconfig ISA_HAS_SPI
  bool "Enable SPI"
  default y
  help
    Provide spi master support.

if ISA_HAS_SPI
config SPI_BASE
  hex "Physical address of the SPI"
  default 0x10001000

config SPI_SIZE
  hex "Size of the SPI"
  default 0x1000
endif # ISA_HAS_SPI

menuconfig ISA_HAS_GPIO
  bool "Enable GPIO"
  default y
  help
    Provide gpio support.

if ISA_HAS_GPIO
config GPIO_BASE
  hex "Physical address of the GPIO"
  default 0x10002000

config GPIO_SIZE
  hex "Size of the GPIO"
  default 0x10
endif # ISA_HAS_GPIO

menuconfig ISA_HAS_PS2
  bool "Enable PS2"
  default y
  help
    Provide ps2 support.

if ISA_HAS_PS2
config PS2_BASE
  hex "Physical address of the PS2"
  default 0x10011000

config PS2_SIZE
  hex "Size of the PS2"
  default 0x8
endif # ISA_HAS_PS2

menuconfig ISA_HAS_MROM
  bool "Enable MROM"
  default y
  help
    Provide mrom support.

if ISA_HAS_MROM
config MROM_BASE
  hex "Physical address of the MROM"
  default 0x20000000

config MROM_SIZE
  hex "Size of the MROM"
  default 0x1000
endif # ISA_HAS_MROM

menuconfig ISA_HAS_VGA
  bool "Enable VGA"
  default y
  help
    Provide vga support.

if ISA_HAS_VGA
config VGA_BASE
  hex "Physical address of the VGA"
  default 0x21000000

config VGA_SIZE
  hex "Size of the VGA"
  default 0x200000
endif # ISA_HAS_VGA

menuconfig ISA_HAS_FLASH
  bool "Enable FLASH"
  default y
  help
    Provide sram support.

if ISA_HAS_FLASH
config FLASH_BASE
  hex "Physical address of the FLASH"
  default 0x30000000

config FLASH_SIZE
  hex "Size of the FLASH"
  default 0x1000000
endif # ISA_HAS_FLASH

menuconfig ISA_HAS_PSRAM
  bool "Enable PSRAM"
  default y
  help
    Provide sram support.

if ISA_HAS_PSRAM
config PSRAM_BASE
  hex "Physical address of the PSRAM"
  default 0x80000000

config PSRAM_SIZE
  hex "Size of the PSRAM"
  default 0x20000000
endif # ISA_HAS_PSRAM

menuconfig ISA_HAS_SDRAM
  bool "Enable SDRAM"
  default y
  help
    Provide sdram support.

if ISA_HAS_SDRAM
config SDRAM_BASE
  hex "Physical address of the SDRAM"
  default 0xA0000000

config SDRAM_SIZE
  hex "Size of the SDRAM"
  default 0x20000000
endif # ISA_HAS_SDRAM

menuconfig ISA_HAS_CHIPLINK
  bool "Enable CHIPLINK"
  default y
  help
    Provide chiplink support.

if ISA_HAS_CHIPLINK
config ISA_HAS_CHIPLINK_MMIO
  bool
  default y

config CHIPLINK_MMIO_BASE
  hex "Physical address of the CHIPLINK MMIO"
  default 0x40000000

config CHIPLINK_MMIO_SIZE
  hex "Size of the CHIPLINK MMIO"
  default 0x40000000

config ISA_HAS_CHIPLINK_MEMO
  bool
  default y

config CHIPLINK_MEM_BASE
  hex "Physical address of the CHIPLINK MEM"
  default 0xc0000000

config CHIPLINK_MEM_SIZE
  hex "Size of the CHIPLINK MEM"
  default 0x40000000
endif # ISA_HAS_CHIPLINK

endmenu
```

## npc/src/main/csrc/memory/Kconfig
```kconfig
menu "Memory Configuration"

config MBASE
  hex "Memory base address"
  default 0x0        if ISA_x86
  default 0x80000000

config MSIZE
  hex "Memory size"
  default 0x8000000

config PC_RESET_OFFSET
  hex "Offset of reset vector from the base of memory"
  default 0x100000 if ISA_x86
  default 0x0

menuconfig HAS_MROM
  bool "Enable MROM"
  default y
  help
    Provide mrom support.

if HAS_MROM
config MROM_BASE
  hex "Physical address of the MROM"
  default 0x20000000

config MROM_SIZE
  hex "Size of the MROM"
  default 0x1000
endif # HAS_MROM

menuconfig HAS_FLASH
  bool "Enable FLASH"
  default y
  help
    Provide sram support.

if HAS_FLASH
config FLASH_BASE
  hex "Physical address of the FLASH"
  default 0x30000000

config FLASH_SIZE
  hex "Size of the FLASH"
  default 0x1000000
endif # HAS_FLASH

menuconfig HAS_PSRAM
  bool "Enable PSRAM"
  default y
  help
    Provide sram support.

if HAS_PSRAM
config PSRAM_BASE
  hex "Physical address of the PSRAM"
  default 0x80000000

config PSRAM_SIZE
  hex "Size of the PSRAM"
  default 0x20000000
endif # HAS_PSRAM

menuconfig HAS_SDRAM
  bool "Enable SDRAM"
  default y
  help
    Provide sdram support.

if HAS_SDRAM
config SDRAM_BASE
  hex "Physical address of the SDRAM"
  default 0xA0000000

config SDRAM_SIZE
  hex "Size of the SDRAM"
  default 0x20000000
endif # HAS_SDRAM

choice
  prompt "Physical memory definition"
  default MEM_GARRAY
config MEM_MALLOC
  bool "Using malloc()"
config MEM_GARRAY
  depends on !TARGET_AM
  bool "Using global array"
endchoice

config MEM_RANDOM
  depends on MODE_SYSTEM && !DIFFTEST && !TARGET_AM
  bool "Initialize the memory with random values"
  default y
  help
    This may help to find undefined behaviors.

endmenu #MEMORY
```
